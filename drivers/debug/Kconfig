## drivers/debug/Kconfig
```kconfig
# When adding new entries keep the list in alphabetical order

config SEC_CACHE_KMSG
	bool "Periodically save kernel log snapshots to mounted cache"
	depends on PRINTK && BLOCK && EXT4_FS=y && DEVTMPFS && SEC_J2Y18LTE_PROJECT
	help
	  Save alternating, fsynced kernel log snapshots every two seconds to
	  /cache/kernel-latest-0.log and /cache/kernel-latest-1.log. Requires
	  a writable ext4 cache with at least 8 MiB spare. A private kernel mount
	  is attempted independently of Android init. Never formats a filesystem.
	  Cannot capture failures before the worker/storage is available or do
	  filesystem I/O safely during a panic. Diagnostic use only.

choice
	prompt "Version of GAF structure"
	depends on SEC_DEBUG
	default SEC_DEBUG_GAF_V5 if PROCA
	default SEC_DEBUG_GAF_V4 if FIVE
	default SEC_DEBUG_GAF_V3

	config SEC_DEBUG_GAF_V3
		bool "Use GAF structure version 3"
		help
		  Default option for FIVE-disabled kernel

	config SEC_DEBUG_GAF_V4
		bool "Use GAF structure version 4"
		help
		  Default option for kernel without PROCA LSM module.

	config SEC_DEBUG_GAF_V5
		bool "Use GAF structure version 5"
		help
		  Default option for kernel with PROCA LSM module.
endchoice

source "drivers/debug/user_reset/Kconfig"
```

## drivers/input/touchscreen/imagis_30xxh/Kconfig.dt2w
```kconfig
#
# Imagis IST30XXH Touchscreen D2TW support
#

config TOUCHSCREEN_IST30XXH_DT2W_SUPPORT
	bool "Firmware-assisted double tap to wake"
	default y
	depends on TOUCHSCREEN_IST30XXH
	help
	  Enable double tap to wake by default using the controller's low-power
	  AOD double-tap event and a wake-capable IRQ. Requires touch firmware
	  that implements this gesture. No software tap detector or polling is
	  used. The factory double_tap command can disable/enable it while the
	  screen is on; changes take effect at the next screen-off transition.
```
